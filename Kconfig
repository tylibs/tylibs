## Kconfig
```kconfig
mainmenu "TYLiBS Framework Configuration"

config TYLIBS_CMAKE
       bool
       default "y"

source "$COMPONENT_KCONFIGS_PROJBUILD_SOURCE_FILE"

menu "Component config"
    comment "!!! MINIMAL_BUILD is enabled !!!"
    depends on "${TYLIBS_MINIMAL_BUILD}"
    comment "Only common components and those transitively required by the main component are listed"
    depends on "${TYLIBS_MINIMAL_BUILD}"
    comment "If a component configuration is missing, please add it to the main component's requirements"
    depends on "${TYLIBS_MINIMAL_BUILD}"

    source "$COMPONENT_KCONFIGS_SOURCE_FILE"
endmenu
```

## components/net/Kconfig
```kconfig
config TYNET
	bool "TyNet Library"
	select SETTINGS if ZEPHYR_PLATFORM
	help
		This option enables the TyNet Library

if TYNET
menu "TyNet configuration"
config TYNET_MQTT_ENABLED
	bool "Enable MQTT support"
	default "n"
	help
		Selects whether Mqtt support is enabled.


config TYNET_LOG
	bool "Enable logging"
	default "y"
	select LOG_COLORS if ESP_PLATFORM
	select LOG_DBG_COLOR_BLUE if ZEPHYR_PLATFORM
	help
		Selects whether logging messages.

endmenu # TyNet configuration
endif # TYNET
```

## components/tyblecom/Kconfig
```kconfig
config TY_BLECOM
	bool "TyBLE Uart Library"
	select SETTINGS if ZEPHYR_PLATFORM
	help
		This option enables the TyBleCom Library

if TY_BLECOM
menu "TyNet configuration"
config TY_BLECOM_LOG
	bool "Enable logging"
	default "y"
	select LOG_COLORS if ESP_PLATFORM
	select LOG_DBG_COLOR_BLUE if ZEPHYR_PLATFORM
	help
		Selects whether logging messages.

endmenu # TyNet configuration
endif # TY_NET
```

## components/tynet/Kconfig
```kconfig
config TY_NET
	bool "TyNet Library"
	select SETTINGS if ZEPHYR_PLATFORM
	select COMPILER_CXX_EXCEPTIONS if ESP_PLATFORM
	help
		This option enables the TyNet Library

if TY_NET
menu "TyNet configuration"
config TY_NET_MQTT_ENABLED
	bool "Enable MQTT support"
	default "n"
	help
		Selects whether Mqtt support is enabled.


config TY_NET_LOG
	bool "Enable logging"
	default "y"
	select LOG_COLORS if ESP_PLATFORM
	select LOG_DBG_COLOR_BLUE if ZEPHYR_PLATFORM
	help
		Selects whether logging messages.

endmenu # TyNet configuration
endif # TY_NET
```

## components/tysettings/Kconfig
```kconfig
config TY_SETTINGS
	bool "TySettings Library"
	select SETTINGS if ZEPHYR_PLATFORM
	help
		This option enables the TySettings Library

if TY_SETTINGS
menu "TySettings configuration"
config TY_SETTINGS_DUALBANK
	bool "Enable Dualbank"
	default "y"
	help
		Selects whether to enable dualbank.
		Gives the ability to have two banks of settings.
		This is useful for having a backup bank of settings.

choice TY_SETTINGS_BACKEND
	prompt "Storage back-end"
	default TY_SETTINGS_NVS if NVS
	default TY_SETTINGS_NONE
	help
		Storage back-end to be used by the settings subsystem.

config TY_SETTINGS_NVS
	bool "NVS non-volatile storage support"
	depends on NVS
	help
		Uses the NVS storage backend.

if TY_SETTINGS_NVS

config TY_SETTINGS_NVS_NAME_CACHE
	bool "NVS name lookup cache"
	help
		Enable NVS name lookup cache, used to reduce the Settings name
		lookup time.

config TY_SETTINGS_NVS_NAME_CACHE_SIZE
	int "NVS name lookup cache size"
	default 128
	range 1 65535
	depends on TY_SETTINGS_NVS_NAME_CACHE
	help
		Number of entries in Settings NVS name cache.

endif # TY_SETTINGS_NVS

config TY_SETTINGS_NONE
	bool "NONE"
	help
		No storage back-end.

endchoice # TY_SETTINGS_BACKEND

config TY_SETTINGS_LOG
	bool "Enable logging"
	default "y"
	select LOG_COLORS if ESP_PLATFORM
	select LOG_DBG_COLOR_BLUE if ZEPHYR_PLATFORM
	help
		Selects whether logging messages.

endmenu # TySettings configuration
endif # TY_SETTINGS
```

## examples/ble/blecom/sdkconfig.defaults
```kconfig
#
# Settings for ESP Thread Border Router
#
CONFIG_SPIRAM_SPEED_80M=y
#CONFIG_SPIRAM_MODE_OCT=y
CONFIG_SPIRAM=y
CONFIG_SPIRAM_USE_CAPS_ALLOC=y
CONFIG_SPIRAM_ALLOW_BSS_SEG_EXTERNAL_MEMORY=y

#
# Partition Table
#
CONFIG_ESPTOOLPY_FLASHSIZE_4MB=y
CONFIG_ESPTOOLPY_FLASHSIZE="4MB"
CONFIG_PARTITION_TABLE_CUSTOM=y
CONFIG_PARTITION_TABLE_CUSTOM_FILENAME="partitions.csv"
CONFIG_PARTITION_TABLE_FILENAME="partitions.csv"
CONFIG_PARTITION_TABLE_OFFSET=0x8000
CONFIG_PARTITION_TABLE_MD5=y

#
# BT config
#
CONFIG_BT_ENABLED=y
CONFIG_BTDM_CTRL_MODE_BLE_ONLY=y
CONFIG_BTDM_CTRL_MODE_BR_EDR_ONLY=n
CONFIG_BTDM_CTRL_MODE_BTDM=n
CONFIG_BT_BLUEDROID_ENABLED=n
CONFIG_BT_NIMBLE_ENABLED=y
```
